## drivers/staging/byeselinux/Kconfig
```kconfig
config BYESELINUX
	tristate "Driver to bypass SELinux at boot"
	default n
	help
	  Android kernel module to bypass SELinux at boot. 
	  Made for XZDualRecovery (Xperia) and Lollipop firmwares.
```
